## conf/layer.conf
```bitbake
# We have a conf and classes directory, add to BBPATH
BBPATH := "${BBPATH}:${LAYERDIR}"

# We have a packages directory, add to BBFILES
BBFILES += "${LAYERDIR}/recipes-*/*/*.bb \
            ${LAYERDIR}/recipes-*/*/*.bbappend"

BBFILE_COLLECTIONS += "meta-dsk"
BBFILE_PATTERN_meta-dsk = "^${LAYERDIR}/"
BBFILE_PRIORITY_meta-dsk = "6"

LAYERVERSION_meta-dsk = "1"

SIGGEN_EXCLUDE_SAFE_RECIPE_DEPS += "\
  oe-dsk-helpers->bash \
"

IMAGE_DSK_BASE := '${LAYERDIR}'
```
